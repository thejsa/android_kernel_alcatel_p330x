/* Copyright (c) 2013, The Linux Foundation. All rights reserved.
 *
 * This program is free software; you can redistribute it and/or modify
 * it under the terms of the GNU General Public License version 2 and
 * only version 2 as published by the Free Software Foundation.
 *
 * This program is distributed in the hope that it will be useful,
 * but WITHOUT ANY WARRANTY; without even the implied warranty of
 * MERCHANTABILITY or FITNESS FOR A PARTICULAR PURPOSE.  See the
 * GNU General Public License for more details.
 */

qcom,rio6-temporary-scud {
	qcom,fcc-mah = <3400>;
	qcom,default-rbatt-mohm = <160>;
	qcom,rbatt-capacitive-mohm = <50>;
	qcom,flat-ocv-threshold-uv = <3800000>;
	qcom,max-voltage-uv = <4350000>;
	qcom,v-cutoff-uv = <3400000>;
	qcom,chg-term-ua = <100000>;
	qcom,batt-id-kohm = <200>;

	qcom,fcc-temp-lut {
		qcom,lut-col-legend = <(-20) 0 25 40 60>;
		qcom,lut-data = <3554 3562 3570 3571 3559>;
	};

	qcom,pc-temp-ocv-lut {
		qcom,lut-col-legend = <(-20) 0 25 40 60>;
		qcom,lut-row-legend = <100 95 90 85 80>,
				<75 70 65 60 55>,
				<50 45 40 35 30>,
				<25 20 16 13 11>,
				<10 9 8 7 6>,
				<5 4 3 2 1>,
				<0>;
		qcom,lut-data = <4330 4329 4326 4321 4313>,
				<4212 4253 4258 4256 4252>,
				<4137 4197 4203 4201 4197>,
				<4085 4145 4151 4148 4144>,
				<4029 4094 4101 4097 4094>,
				<3933 4043 4055 4049 4046>,
				<3893 3965 3997 4001 4002>,
				<3853 3921 3961 3965 3962>,
				<3824 3893 3921 3925 3922>,
				<3807 3862 3874 3877 3876>,
				<3793 3835 3841 3841 3841>,
				<3778 3810 3818 3819 3818>,
				<3764 3789 3800 3800 3799>,
				<3748 3773 3784 3784 3783>,
				<3731 3760 3771 3768 3763>,
				<3712 3743 3759 3751 3739>,
				<3688 3724 3740 3731 3717>,
				<3665 3712 3714 3705 3691>,
				<3643 3703 3691 3682 3670>,
				<3625 3697 3688 3680 3668>,
				<3615 3694 3687 3679 3668>,
				<3603 3690 3686 3679 3667>,
				<3592 3685 3685 3677 3665>,
				<3575 3677 3682 3675 3662>,
				<3557 3665 3677 3668 3649>,
				<3532 3644 3657 3642 3615>,
				<3500 3610 3613 3592 3561>,
				<3456 3559 3548 3524 3488>,
				<3387 3482 3456 3427 3386>,
				<3270 3346 3311 3276 3221>,
				<3000 3000 3000 3000 3000>;
	};

	qcom,rbatt-sf-lut {
		qcom,lut-col-legend = <(-20) 0 25 40 60>;
		qcom,lut-row-legend = <100 95 90 85 80>,
				<75 70 65 60 55>,
				<50 45 40 35 30>,
				<25 20 16 13 11>,
				<10 9 8 7 6>,
				<5 4 3 2 1>;
		qcom,lut-data = <1298 253 100 88 85>,
				<1294 253 100 88 85>,
				<1209 258 101 88 86>,
				<1155 263 103 90 86>,
				<1105 263 107 91 87>,
				<992 267 112 93 88>,
				<981 242 115 95 90>,
				<967 237 124 100 93>,
				<974 240 123 105 96>,
				<1005 236 107 96 91>,
				<1046 236 101 89 86>,
				<1093 238 101 90 87>,
				<1137 238 102 91 88>,
				<1180 241 104 93 91>,
				<1228 250 105 92 90>,
				<1285 259 105 90 87>,
				<1346 270 103 89 86>,
				<1371 285 101 88 86>,
				<1314 286 100 87 85>,
				<1367 299 100 88 86>,
				<1408 307 101 90 87>,
				<1439 318 103 91 89>,
				<1534 328 105 93 91>,
				<1654 340 108 95 94>,
				<1800 350 111 97 93>,
				<1988 356 110 92 89>,
				<2252 363 106 91 89>,
				<2671 380 107 93 91>,
				<3608 409 113 98 105>,
				<9684 472 142 141 316>;
	};
};
