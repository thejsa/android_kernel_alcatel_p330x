/* Copyright (c) 2013, The Linux Foundation. All rights reserved.
 *
 * This program is free software; you can redistribute it and/or modify
 * it under the terms of the GNU General Public License version 2 and
 * only version 2 as published by the Free Software Foundation.
 *
 * This program is distributed in the hope that it will be useful,
 * but WITHOUT ANY WARRANTY; without even the implied warranty of
 * MERCHANTABILITY or FITNESS FOR A PARTICULAR PURPOSE.  See the
 * GNU General Public License for more details.
 */


/dts-v1/;
/* [PLATFORM]-Mod-BEGIN by TCTNB.WQF, 2013/08/15, rename the dtsi name for riol */
/include/ "msm8926-rio5_ctcc.dtsi"
/include/ "msm8226-720p-mtp-rio5_ctcc.dtsi"
/include/ "msm8226-camera-sensor-mtp-rio5_ctcc.dtsi"
/* [PLATFORM]-Mod-END by TCTNB.WQF */

/ {
	model = "Qualcomm MSM 8926 MTP";
	compatible = "qcom,msm8926-mtp", "qcom,msm8926", "qcom,mtp";
/* [PLATFORM]-Mod-BEGIN by TCTNB.WQF, 2013/08/15, modify the hardware version for riol */
	qcom,msm-id = <200 8 0x20000>;
/* [PLATFORM]-Mod-END by TCTNB.WQF */
/*
	qcom,board-id = <8 0>;
*/
};
