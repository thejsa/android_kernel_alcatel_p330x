/* Copyright (c) 2013, The Linux Foundation. All rights reserved.
 *
 * This program is free software; you can redistribute it and/or modify
 * it under the terms of the GNU General Public License version 2 and
 * only version 2 as published by the Free Software Foundation.
 *
 * This program is distributed in the hope that it will be useful,
 * but WITHOUT ANY WARRANTY; without even the implied warranty of
 * MERCHANTABILITY or FITNESS FOR A PARTICULAR PURPOSE.  See the
 * GNU General Public License for more details.
 */

/*---------------------------------------------------------------------------
 * This file is autogenerated file using gcdb parser. Please do not edit it.
 * Update input XML file to add a new entry or update variable in this file
 * VERSION = "1.0"
 *---------------------------------------------------------------------------*/
&mdss_mdp {
	dsi_hx8379a_fwvga_vid: qcom,mdss_dsi_hx8379a_fwvga_video {
		compatible = "qcom,mdss-dsi-panel";
		status = "disable";
		qcom,mdss-dsi-panel-name = "hx8379a fwvga video mode dsi panel";
		qcom,mdss-dsi-panel-controller = <&mdss_dsi0>;
		qcom,mdss-dsi-panel-width = <480>;
		qcom,mdss-dsi-panel-height = <854>;
		qcom,mdss-pan-physical-width-dimension = <0>;
		qcom,mdss-pan-physical-height-dimension = <0>;
		qcom,mdss-dsi-h-left-border = <0>;
		qcom,mdss-dsi-h-right-border = <0>;
		qcom,mdss-dsi-v-top-border = <0>;
		qcom,mdss-dsi-v-bottom-border = <0>;
		qcom,mdss-dsi-bpp = <24>;
		qcom,mdss-dsi-panel-type = "dsi_video_mode";
		qcom,mdss-dsi-pixel-packing = <0>; /* used for 16bit mode*/
		qcom,mdss-dsi-panel-destination = "display_1";
/*
		qcom,mdss-dsi-h-front-porch = <100>;
		qcom,mdss-dsi-h-back-porch = <100>;
		qcom,mdss-dsi-h-pulse-width = <15>;
		qcom,mdss-dsi-h-sync-skew = <0>;
		qcom,mdss-dsi-v-back-porch = <9>;
		qcom,mdss-dsi-v-front-porch = <20>;
		qcom,mdss-dsi-v-pulse-width = <2>;
		qcom,mdss-dsi-panel-clockrate = <442850000>;
		qcom,mdss-dsi-panel-timings = [2f 1c 12 00 40 44 16 1e 17 03 04 00];
		qcom,mdss-dsi-t-clk-post = <0x04>;
		qcom,mdss-dsi-t-clk-pre = <0x12>;
*/
		qcom,mdss-dsi-h-front-porch = <43>;
		qcom,mdss-dsi-h-back-porch = <43>;
		qcom,mdss-dsi-h-pulse-width = <42>;
		qcom,mdss-dsi-h-sync-skew = <0>;
		qcom,mdss-dsi-v-back-porch = <9>;
		qcom,mdss-dsi-v-front-porch = <6>;
		qcom,mdss-dsi-v-pulse-width = <2>;
		qcom,mdss-dsi-panel-clockrate = <368580000>;
		qcom,mdss-dsi-panel-timings = [2f 18 0e 00 38 3e 12 1a 13 03 04 00];
		qcom,mdss-dsi-t-clk-post = <0x05>;
		qcom,mdss-dsi-t-clk-pre = <0x11>;

		qcom,mdss-dsi-underflow-color = <0xff>;
		qcom,mdss-dsi-border-color = <0>;
		qcom,mdss-dsi-bl-pmic-control-type = "bl_ctrl_wled";
//		qcom,mdss-dsi-bl-pmic-pwm-frequency = <50>;
//		qcom,mdss-dsi-bl-pmic-bank-select = <0>;
//		qcom,mdss-dsi-pwm-gpio = <&pm8941_mpps 5 0>;
		qcom,mdss-dsi-bl-min-level = <1>;
		qcom,mdss-dsi-bl-max-level = <255>;
		qcom,mdss-dsi-interleave-mode = <0>;
/* lcd panel infor type */
//		qcom,mdss-dsi-te-check-enable;
//		qcom,mdss-dsi-te-using-te-pin;
/* for video mode  */
		qcom,mdss-dsi-h-sync-pulse = <1>;
//		qcom,mdss-dsi-hfp-power-mode;
//		qcom,mdss-dsi-hsa-power-mode;
//		qcom,mdss-dsi-hbp-power-mode;
		qcom,mdss-dsi-bllp-power-mode;
		qcom,mdss-dsi-bllp-eof-power-mode;
		qcom,mdss-dsi-traffic-mode = "non_burst_sync_pulse";
// non_burst_sync_pulse
// non_burst_sync_event
// burst_mode
		qcom,mdss-dsi-panel-framerate = <58>;
/*  for command mode */
		qcom,mdss-dsi-te-dcs-command = <1>;
		qcom,mdss-dsi-te-v-sync-continue-lines = <0x3c>;
		qcom,mdss-dsi-te-v-sync-rd-ptr-irq-line = <0x2c>;
		qcom,mdss-dsi-te-pin-select = <1>;
		qcom,mdss-dsi-stream = <0>;
		qcom,mdss-dsi-mdp-trigger = "none";
		qcom,mdss-dsi-dma-trigger = "trigger_sw";
		qcom,mdss-dsi-virtual-channel-id = <0>;
		qcom,mdss-dsi-color-order = <2>;
		qcom,mdss-dsi-lane-0-state;
		qcom,mdss-dsi-lane-1-state;
//		qcom,mdss-dsi-lane-2-state;
//		qcom,mdss-dsi-lane-3-state;
		qcom,mdss-dsi-lane-map = "lane_map_0123";
		qcom,mdss-dsi-on-command = [39 01 00 00 00 00 04 B9 FF 83 79
			39 01 00 00 00 00 03 BA 51 93
			39 01 00 00 00 00 14 B1 00 50 44 EA 99 08 11 11 71 1A 22 9A 1A 42 0B 4A F1 00 E6
			39 01 00 00 00 00 0e B2 00 00 FE 08 0C 19 22 00 FF 08 0C 19 20
			39 01 00 00 00 00 20 B4 80 06 00 32 10 03 32 13 5F 32 10 08 35 01 28 07 37 00 3C 1A 3E 3E 0C 00 40 08 28 08 30 30 04
			39 01 00 00 00 00 30 D5 00 00 0A 00 01 05 00 00 18 88 99 88 01 45 88 88 01 45 23 67 88 88 88 88 88 88 88 99 54 10 88 88 76 32 54 10 88 88 88 88 88 00 00 00 00 00 00
			39 01 00 00 00 00 24 E0 79 12 13 14 15 16 3F 25 36 06 12 10 14 16 14 15 11 16 12 13 14 15 16 3F 25 36 06 12 10 14 16 14 15 11 16
                        39 01 00 00 00 00 05 B6 00 6A 00 6A
			15 01 00 00 00 00 02 CC 02
			15 01 00 00 00 00 02 35 00
			05 01 00 00 96 00 02 11 00
			05 01 00 00 14 00 02 29 00];

/*
		qcom,mdss-dsi-on-command = [39 01 00 00 00 00 04 B9 FF 83 79
			15 01 00 00 00 00 02 BA 51
			39 01 00 00 00 00 20 B1 00 50 44 EA 99 08 11 11 71 1A 22 9A 1A 42 0B 4A F1 00 E6 E6 E6 E6 E6 00 04 05 0A 0B 04 05 00
			39 01 00 00 00 00 0e B2 00 00 FE 08 0C 19 22 00 FF 08 0C 19 20
			39 01 00 00 00 00 20 B4 80 06 00 32 10 03 32 13 5F 32 10 08 35 01 28 07 37 00 3C 1A 3E 3E 0C 00 40 08 28 08 30 30 04
			39 01 00 00 00 00 30 D5 00 00 0A 00 01 05 00 00 18 88 99 88 01 45 88 88 01 45 23 67 88 88 88 88 88 88 88 99 54 10 88 88 76 32 54 10 88 88 88 88 88 00 00 00 00 00 00
			39 01 00 00 00 00 04 DE 05 70 04
			39 01 00 00 00 00 24 E0 79 07 09 0a 15 16 3F 27 38 06 12 10 14 16 14 15 11 17 07 09 0a 15 16 3F 27 38 06 12 10 14 16 14 15 11 17
			15 01 00 00 00 00 02 CC 02
			15 01 00 00 00 00 02 35 00
			05 01 00 00 78 00 02 11 00
			05 01 00 00 1e 00 02 29 00];
*/
		qcom,mdss-dsi-off-command = [05 01 00 00 32 00 02 28 00
					05 01 00 00 78 00 02 10 00];
		qcom,mdss-dsi-on-command-state = "dsi_lp_mode";
		qcom,mdss-dsi-off-command-state = "dsi_hs_mode";
		qcom,mdss-dsi-reset-sequence = <1 20>, <0 2>, <1 20>;
	};
};
