/* Copyright (c) 2013, The Linux Foundation. All rights reserved.
 *
 * This program is free software; you can redistribute it and/or modify
 * it under the terms of the GNU General Public License version 2 and
 * only version 2 as published by the Free Software Foundation.
 *
 * This program is distributed in the hope that it will be useful,
 * but WITHOUT ANY WARRANTY; without even the implied warranty of
 * MERCHANTABILITY or FITNESS FOR A PARTICULAR PURPOSE.  See the
 * GNU General Public License for more details.
 */

/*---------------------------------------------------------------------------
 * This file is autogenerated file using gcdb parser. Please do not edit it.
 * Update input XML file to add a new entry or update variable in this file
 * VERSION = "1.0"
 *---------------------------------------------------------------------------*/
&mdss_mdp {
	dsi_nt35512_wvga_vid: qcom,mdss_dsi_nt35512_wvga_video {
		compatible = "qcom,mdss-dsi-panel";
		status = "disable";
		qcom,mdss-dsi-panel-name = "nt35512 video mode panel";
		qcom,mdss-dsi-panel-controller = <&mdss_dsi0>;
		qcom,mdss-dsi-panel-type = "dsi_video_mode";
		qcom,mdss-dsi-panel-destination = "display_1";
		qcom,mdss-dsi-pixel-packing = <0>; /* used for 16bit mode*/
        qcom,mdss-dsi-panel-framerate = <50>;
        qcom,mdss-dsi-virtual-channel-id = <0>;
		qcom,mdss-dsi-stream = <0>;
		qcom,mdss-dsi-panel-width = <480>;
		qcom,mdss-dsi-panel-height = <800>;
		qcom,mdss-dsi-h-front-porch = <100>;
		qcom,mdss-dsi-h-back-porch = <140>;
		qcom,mdss-dsi-h-pulse-width = <120>;
		qcom,mdss-dsi-h-sync-skew = <0>;
		qcom,mdss-dsi-v-back-porch = <10>;
		qcom,mdss-dsi-v-front-porch = <20>;
		qcom,mdss-dsi-v-pulse-width = <2>;
		qcom,mdss-dsi-h-left-border = <0>;
		qcom,mdss-dsi-h-right-border = <0>;
		qcom,mdss-dsi-v-top-border = <0>;
		qcom,mdss-dsi-v-bottom-border = <0>;
		qcom,mdss-pan-physical-width-dimension = <0>;
		qcom,mdss-pan-physical-height-dimension = <0>;
		qcom,mdss-dsi-bpp = <24>;
		qcom,mdss-dsi-color-order = <0>;
		qcom,mdss-dsi-underflow-color = <0xff>;
		qcom,mdss-dsi-border-color = <0>;
		qcom,mdss-dsi-on-command = [
                    39 01 00 00 00 00 06
                        F0 55 AA 52 08 01
                    39 01 00 00 00 00 04
                        BC 00 58 1A
                    39 01 00 00 00 00 04
                        BD 00 58 1A
                    39 01 00 00 00 00 03
                        BE 00 48
                    39 01 00 00 00 00 35
                        D1 00 00 00 01 00 08 00 16 00 29 00 54 00 85 00 D6 01 13 01 6A 01 A8 01 FF 02 3F 02 41 02 7B 02 B6 02 D6 02 FA 03 12 03 30 03 43 03 5B 03 6C 03 85 03 B9 03 FD
                    39 01 00 00 00 00 35
                        D2 00 00 00 01 00 08 00 16 00 29 00 54 00 85 00 D6 01 13 01 6A 01 A8 01 FF 02 3F 02 41 02 7B 02 B6 02 D6 02 FA 03 12 03 30 03 43 03 5B 03 6C 03 85 03 B9 03 FD
                    39 01 00 00 00 00 35
                        D3 00 00 00 01 00 08 00 16 00 29 00 54 00 85 00 D6 01 13 01 6A 01 A8 01 FF 02 3F 02 41 02 7B 02 B6 02 D6 02 FA 03 12 03 30 03 43 03 5B 03 6C 03 85 03 B9 03 FD
                    39 01 00 00 00 00 35
                        D4 00 00 00 01 00 08 00 16 00 29 00 54 00 85 00 D6 01 13 01 6A 01 A8 01 FF 02 3F 02 41 02 7B 02 B6 02 D6 02 FA 03 12 03 30 03 43 03 5B 03 6C 03 85 03 B9 03 FD
                    39 01 00 00 00 00 35
                        D5 00 00 00 01 00 08 00 16 00 29 00 54 00 85 00 D6 01 13 01 6A 01 A8 01 FF 02 3F 02 41 02 7B 02 B6 02 D6 02 FA 03 12 03 30 03 43 03 5B 03 6C 03 85 03 B9 03 FD
                    39 01 00 00 00 00 35
                        D6 00 00 00 01 00 08 00 16 00 29 00 54 00 85 00 D6 01 13 01 6A 01 A8 01 FF 02 3F 02 41 02 7B 02 B6 02 D6 02 FA 03 12 03 30 03 43 03 5B 03 6C 03 85 03 B9 03 FD
                    39 01 00 00 00 00 04
                        B0 0D 0D 0D
                    39 01 00 00 00 00 04
                        B1 0D 0D 0D
                    39 01 00 00 00 00 04
                        B6 44 44 44
                    39 01 00 00 00 00 04
                        B7 26 26 26
                    39 01 00 00 00 00 04
                        B9 34 34 34
                    39 01 00 00 00 00 04
                        BA 16 16 16
                    39 01 00 00 00 00 06
                        F0 55 AA 52 08 00
					15 01 00 00 00 00 02
					    B1 FC
					15 01 00 00 00 00 02
					    B4 10
					15 01 00 00 00 00 02
					    B6 04
                    39 01 00 00 00 00 03
                        B7 74 74
                    39 01 00 00 00 00 05
                        B8 01 07 07 07
                    39 01 00 00 00 00 04
                        BC 02 02 02
                    39 01 00 00 00 00 06
                        BD 01 84 07 31 00
                    39 01 00 00 00 00 06
                        BE 01 84 07 31 00
                    39 01 00 00 00 00 06
                        BF 01 84 07 31 00
					15 01 00 00 00 00 02
					    35 00
					15 01 00 00 00 00 02
					    3A 77
                    39 01 00 00 00 00 06
                        F0 55 AA 52 08 00
					15 01 00 00 00 00 02
					    C7 02
					15 01 00 00 00 00 02
					    C9 11       
                    39 01 00 00 00 00 0D
                        CA 01 E4 E4 E4 E4 E4 E4 E4 08 08 00 00
					15 01 00 00 00 00 02
                        B1 FC
					15 01 00 00 96 00 02
					    11 00
					15 01 00 00 00 00 02
					    29 00
                    39 01 00 00 00 00 06
                        F0 55 AA 52 08 01
                    39 01 00 00 00 00 05
                        FF AA 55 A5 80
                    39 01 00 00 00 00 10
                        F7 63 40 00 00 00 01 C4 A2 00 02 64 54 48 00 D0
                    39 01 00 00 00 00 05
                        FF AA 55 A5 00
];
		qcom,mdss-dsi-off-command = [05 01 00 00 32 00 02 28 00
					05 01 00 00 78 00 02 10 00];

		qcom,mdss-dsi-on-command-state = "dsi_lp_mode";
		qcom,mdss-dsi-off-command-state = "dsi_hs_mode";
		qcom,mdss-dsi-h-sync-pulse = <1>;
		qcom,mdss-dsi-traffic-mode = "non_burst_sync_event";
		qcom,mdss-dsi-lane-map = "lane_map_3012";
		qcom,mdss-dsi-bllp-eof-power-mode;
		qcom,mdss-dsi-bllp-power-mode;
		qcom,mdss-dsi-lane-0-state;
		qcom,mdss-dsi-lane-1-state;
//		qcom,mdss-dsi-lane-2-state;
//		qcom,mdss-dsi-lane-3-state;
		qcom,mdss-dsi-panel-timings = [BB 1A 10 00 3E 40 16 1E 15 03 04 00];
		qcom,mdss-dsi-t-clk-post = <0x04>;
		qcom,mdss-dsi-t-clk-pre = <0x33>;
		qcom,mdss-dsi-panel-clockrate = <419300000>;
		qcom,mdss-dsi-bl-min-level = <1>;
		qcom,mdss-dsi-bl-max-level = <255>;
		qcom,mdss-dsi-interleave-mode = <0>;
		qcom,mdss-dsi-dma-trigger = "trigger_sw";
		qcom,mdss-dsi-mdp-trigger = "none";
		qcom,mdss-dsi-bl-pmic-control-type = "bl_ctrl_wled";
		qcom,mdss-dsi-reset-sequence = <1 20>, <0 2>, <1 20>;
	};
};
