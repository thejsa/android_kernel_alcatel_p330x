/* Copyright (c) 2013, The Linux Foundation. All rights reserved.
 *
 * This program is free software; you can redistribute it and/or modify
 * it under the terms of the GNU General Public License version 2 and
 * only version 2 as published by the Free Software Foundation.
 *
 * This program is distributed in the hope that it will be useful,
 * but WITHOUT ANY WARRANTY; without even the implied warranty of
 * MERCHANTABILITY or FITNESS FOR A PARTICULAR PURPOSE.  See the
 * GNU General Public License for more details.
 */

/*---------------------------------------------------------------------------
 * This file is autogenerated file using gcdb parser. Please do not edit it.
 * Update input XML file to add a new entry or update variable in this file
 * VERSION = "1.0"
 *---------------------------------------------------------------------------*/
&mdss_mdp {
	dsi_nt51018_52003_1024_600_vid: qcom,mdss_dsi_nt51018_52003_1024_600_vdo {
		compatible = "qcom,mdss-dsi-panel";
		status = "disable";
		qcom,mdss-dsi-panel-name = "nt51018_52003 video mode dsi panel";
		qcom,mdss-dsi-panel-controller = <&mdss_dsi0>;
		qcom,mdss-dsi-panel-width = <1024>;
		qcom,mdss-dsi-panel-height = <600>;
		qcom,mdss-pan-physical-width-dimension = <0>;
		qcom,mdss-pan-physical-height-dimension = <0>;
		qcom,mdss-dsi-h-left-border = <0>;
		qcom,mdss-dsi-h-right-border = <0>;
		qcom,mdss-dsi-v-top-border = <0>;
		qcom,mdss-dsi-v-bottom-border = <0>;
		qcom,mdss-dsi-bpp = <24>;
		qcom,mdss-dsi-panel-type = "dsi_video_mode";
		qcom,mdss-dsi-pixel-packing = <0>; /* used for 16bit mode*/
		qcom,mdss-dsi-panel-destination = "display_1";
		qcom,mdss-dsi-h-front-porch = <100>;
		qcom,mdss-dsi-h-back-porch = <100>;
		qcom,mdss-dsi-h-pulse-width = <120>;
		qcom,mdss-dsi-h-sync-skew = <0>;
		qcom,mdss-dsi-v-back-porch = <13>;
		qcom,mdss-dsi-v-front-porch = <12>;
		qcom,mdss-dsi-v-pulse-width = <10>;
		qcom,mdss-dsi-panel-clock-rate = <449040000>;
		qcom,mdss-dsi-panel-timings = [37 1c 12 00 40 44 16 1e 17 03 04 00];
		qcom,mdss-dsi-t-clk-post = <0x04>;
		qcom,mdss-dsi-t-clk-pre = <0x12>;
		qcom,mdss-dsi-underflow-color = <0xff>;
		qcom,mdss-dsi-border-color = <0>;
		qcom,mdss-dsi-bl-pmic-control-type = "bl_ctrl_wled";
//		qcom,mdss-dsi-bl-pmic-pwm-frequency = <50>;
//		qcom,mdss-dsi-bl-pmic-bank-select = <0>;
//		qcom,mdss-dsi-pwm-gpio = <&pm8941_mpps 5 0>;
		qcom,mdss-dsi-bl-min-level = <1>;
		qcom,mdss-dsi-bl-max-level = <255>;
		qcom,mdss-dsi-interleave-mode = <0>;
/* lcd panel infor type */
//		qcom,mdss-dsi-te-check-enable;
//		qcom,mdss-dsi-te-using-te-pin;
/* for video mode  */
		qcom,mdss-dsi-h-sync-pulse = <1>;
//		qcom,mdss-dsi-hfp-power-mode;
//		qcom,mdss-dsi-hsa-power-mode;
//		qcom,mdss-dsi-hbp-power-mode;
		qcom,mdss-dsi-bllp-power-mode;
		qcom,mdss-dsi-bllp-eof-power-mode;
		qcom,mdss-dsi-traffic-mode = <1>;
		qcom,mdss-dsi-panel-framerate = <58>;//modify by yusen.ke.sz@tcl.com at 20140416 for CTS TEST
/*  for command mode */
		qcom,mdss-dsi-te-dcs-command = <0>;	// 1
		qcom,mdss-dsi-te-v-sync-continue-lines = <0>;	//0x3c
		qcom,mdss-dsi-te-v-sync-rd-ptr-irq-line = <0>;	//0x2c
		qcom,mdss-dsi-te-pin-select = <0>;	// 1
		qcom,mdss-dsi-stream = <0>;
		qcom,mdss-dsi-mdp-trigger = <0>;
		qcom,mdss-dsi-dma-trigger = <4>;
		qcom,mdss-dsi-virtual-channel-id = <0>;
		qcom,mdss-dsi-color-order = <0>;	// 2
		qcom,mdss-dsi-lane-0-state;
		qcom,mdss-dsi-lane-1-state;
		qcom,mdss-dsi-lane-2-state;
		qcom,mdss-dsi-lane-3-state;
		qcom,mdss-dsi-lane-map = <0>;
		qcom,mdss-dsi-on-command = [
			15 01 00 00 00 00 02 A1 FE
			//15 01 00 00 00 00 02 A2 EF
			];
		//qcom,mdss-dsi-off-command = [05 01 00 00 32 00 02 28 00
		//			05 01 00 00 78 00 02 10 00];
		qcom,mdss-dsi-off-command = [];
		qcom,mdss-dsi-on-command-state = "dsi_lp_mode";
		qcom,mdss-dsi-off-command-state = "dsi_hs_mode";
		qcom,mdss-dsi-reset-sequence = <1 20>, <0 2>, <1 20>;
		//qcom,mdss-dsi-reset-sequence = <1 20>, <0 20>, <1 20>;
	};
};
