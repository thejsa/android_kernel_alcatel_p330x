/* Copyright (c) 2013, The Linux Foundation. All rights reserved.
 *
 * This program is free software; you can redistribute it and/or modify
 * it under the terms of the GNU General Public License version 2 and
 * only version 2 as published by the Free Software Foundation.
 *
 * This program is distributed in the hope that it will be useful,
 * but WITHOUT ANY WARRANTY; without even the implied warranty of
 * MERCHANTABILITY or FITNESS FOR A PARTICULAR PURPOSE.  See the
 * GNU General Public License for more details.
 */

/*---------------------------------------------------------------------------
 * This file is autogenerated file using gcdb parser. Please do not edit it.
 * Update input XML file to add a new entry or update variable in this file
 * VERSION = "1.0"
 *---------------------------------------------------------------------------*/
&mdss_mdp {
	dsi_hx8389b_qhd_rio6_tf_vid: qcom,mdss_dsi_hx8389b_qhd_video {
		compatible = "qcom,mdss-dsi-panel";
		status = "disable";
		qcom,mdss-dsi-panel-name = "hx8389b video mode rio6_tf dsi panel";
		qcom,mdss-dsi-panel-controller = <&mdss_dsi0>;
		qcom,mdss-dsi-panel-type = "dsi_video_mode";
		qcom,mdss-dsi-panel-destination = "display_1";
		qcom,mdss-dsi-pixel-packing = <0>; /* used for 16bit mode*/
        qcom,mdss-dsi-panel-framerate = <58>;
        qcom,mdss-dsi-virtual-channel-id = <0>;
		qcom,mdss-dsi-stream = <0>;
		qcom,mdss-dsi-panel-width = <540>;
		qcom,mdss-dsi-panel-height = <960>;
		qcom,mdss-dsi-h-front-porch = <50>;
		qcom,mdss-dsi-h-back-porch = <50>;
		qcom,mdss-dsi-h-pulse-width = <15>;
		qcom,mdss-dsi-h-sync-skew = <0>;
		qcom,mdss-dsi-v-back-porch = <13>;
		qcom,mdss-dsi-v-front-porch = <10>;
		qcom,mdss-dsi-v-pulse-width = <2>;
		qcom,mdss-dsi-h-left-border = <0>;
		qcom,mdss-dsi-h-right-border = <0>;
		qcom,mdss-dsi-v-top-border = <0>;
		qcom,mdss-dsi-v-bottom-border = <0>;
		qcom,mdss-pan-physical-width-dimension = <0>;
		qcom,mdss-pan-physical-height-dimension = <0>;
		qcom,mdss-dsi-bpp = <24>;
		qcom,mdss-dsi-color-order = <0>;
		qcom,mdss-dsi-underflow-color = <0xff>;
		qcom,mdss-dsi-border-color = <0>;
		qcom,mdss-dsi-reset-command = [
            05 01 00 00 C8 00 02 11 00
            05 01 00 00 64 00 02 29 00
            05 01 00 00 64 00 02 38 00
        ];
		qcom,mdss-dsi-on-command = [
            39 01 00 00 00 00 04
                B9 FF 83 89
            15 01 00 00 00 00 02
                BA 41
            39 01 00 00 00 00 14
                B1 00 00 06 Ef 97 10 11 93 EF 24 2C 3F 3F 43 01 12 F2 00 E6
            39 01 00 00 00 00 08
                B2 00 00 78 0C 07 3F c0
            39 01 00 00 00 00 18
                B4 80 08 00 32 10 04 32 10 00 32 10 00 37 0A 40 08 37 00 46 06 5C 5C 06
            39 01 00 00 00 00 03
                C0 43 17
            39 01 00 00 00 00 39
                D5 00 00 00 00 01 00 00 00 60 00 99 88 AA BB 88 23 88 01 88 67 88 45 01 23 88 88 88 88 88 88 99 BB AA 88 54 88 76 88 10 88 32 32 10 88 88 88 88 88 00 04 00 00 00 00 00 00
            39 01 00 00 00 00 04
                B7 00 00 50
            39 01 00 00 00 00 05
                B6 00 89 00 89
            39 01 00 00 00 00 23
                E0 05 11 16 37 3F 3F 23 3F 09 0E 0D 12 14 12 14 1D 1C 05 11 16 37 3F 3F 23 3F 09 0E 0D 12 14 12 14 1D 1C
            39 01 00 00 00 00 80
                C1 01 00 0E 20 29 2F 35 42 4E 59 62 6C 76 7F 86 8F 97 9E A4 AB B1 B8 C0 C8 CD D3 DA E1 E5 EB F1 F5 FA FF 19 FE 2E F5 62 F4 45 2D C0 00 0E 20 29 2F 35 42 4E 59 62 6C 76 7F 86 8F 97 9E A4 AB B1 B8 C0 C8 CD D3 DA E1 E5 EB F1 F5 FA FF 19 FE 2E F5 62 F4 45 2D C0 00 0E 20 29 2F 35 42 4E 59 62 6C 76 7F 86 8F 97 9E A4 AB B1 B8 C0 C8 CD D3 DA E1 E5 EB F1 F5 FA FF 19 FE 2E F5 62 F4 45 2D C0
            15 01 00 00 00 00 02
                CC 02
            15 01 00 00 00 00 02
                35 00
            05 01 00 00 C8 00 02 11 00
            05 01 00 00 64 00 02 29 00
        ];
        qcom,mdss-dsi-displayon-command = [05 01 00 00 64 00 02 29 00];
		qcom,mdss-dsi-off-command = [05 01 00 00 0a 00 02 28 00];
		qcom,mdss-sleep-in-command = [05 01 00 00 96 00 02 10 00];
		qcom,mdss-dsi-on-command-state = "dsi_lp_mode";
		qcom,mdss-dsi-off-command-state = "dsi_hs_mode";
		qcom,mdss-dsi-h-sync-pulse = <1>;
		qcom,mdss-dsi-traffic-mode = "non_burst_sync_event";
		qcom,mdss-dsi-lane-map = "lane_map_3012";
		qcom,mdss-dsi-bllp-eof-power-mode;
		qcom,mdss-dsi-bllp-power-mode;
		qcom,mdss-dsi-lane-0-state;
		qcom,mdss-dsi-lane-1-state;
		qcom,mdss-dsi-panel-clockrate = <449000000>;
		qcom,mdss-dsi-panel-timings = [bf 1c 12 00 40 44 16 1e 17 03 04 00];
		qcom,mdss-dsi-t-clk-post = <0x04>;
		qcom,mdss-dsi-t-clk-pre = <0x34>;
		qcom,mdss-dsi-bl-min-level = <1>;
		qcom,mdss-dsi-bl-max-level = <255>;
		qcom,mdss-dsi-interleave-mode = <0>;
		qcom,mdss-dsi-dma-trigger = "trigger_sw";
		qcom,mdss-dsi-mdp-trigger = "none";
		qcom,mdss-dsi-bl-pmic-control-type = "bl_ctrl_wled";
		qcom,mdss-dsi-reset-sequence = <1 20>, <0 2>, <1 20>;
	};
};
