/* Copyright (c) 2013, The Linux Foundation. All rights reserved.
 *
 * This program is free software; you can redistribute it and/or modify
 * it under the terms of the GNU General Public License version 2 and
 * only version 2 as published by the Free Software Foundation.
 *
 * This program is distributed in the hope that it will be useful,
 * but WITHOUT ANY WARRANTY; without even the implied warranty of
 * MERCHANTABILITY or FITNESS FOR A PARTICULAR PURPOSE.  See the
 * GNU General Public License for more details.
 */

qcom,miata-temporary-byd {
	qcom,fcc-mah = <2000>;
	qcom,default-rbatt-mohm = <158>;
	qcom,rbatt-capacitive-mohm = <50>;
	qcom,flat-ocv-threshold-uv = <3800000>;
	qcom,max-voltage-uv = <4350000>;
	qcom,v-cutoff-uv = <3400000>;
	qcom,chg-term-ua = <100000>;
	qcom,batt-id-kohm = <21>;

	qcom,fcc-temp-lut {
		qcom,lut-col-legend = <(-20) 0 25 40 60>;
		qcom,lut-data = <2004 1990 1989 1991 1988>;
	};

	qcom,pc-temp-ocv-lut {
		qcom,lut-col-legend = <(-20) 0 25 40 60>;
		qcom,lut-row-legend = <100 95 90 85 80>,
				<75 70 65 60 55>,
				<50 45 40 35 30>,
				<25 20 16 13 11>,
				<10 9 8 7 6>,
				<5 4 3 2 1>,
				<0>;
		qcom,lut-data = <4331 4327 4321 4317 4309>,
				<4229 4250 4251 4250 4245>,
				<4159 4191 4193 4193 4188>,
				<4094 4136 4139 4138 4134>,
				<4042 4083 4086 4086 4082>,
				<3968 4026 4039 4038 4034>,
				<3922 3965 3991 3993 3990>,
				<3883 3924 3953 3954 3950>,
				<3846 3888 3909 3915 3913>,
				<3809 3857 3863 3866 3865>,
				<3791 3831 3833 3833 3832>,
				<3777 3808 3811 3811 3809>,
				<3763 3790 3793 3793 3791>,
				<3749 3774 3779 3778 3776>,
				<3733 3764 3769 3765 3759>,
				<3716 3751 3758 3751 3737>,
				<3693 3727 3738 3729 3716>,
				<3665 3706 3710 3703 3690>,
				<3632 3696 3688 3681 3669>,
				<3604 3691 3682 3675 3664>,
				<3585 3688 3681 3674 3662>,
				<3563 3685 3679 3673 3661>,
				<3534 3681 3678 3670 3659>,
				<3497 3674 3674 3667 3655>,
				<3453 3663 3667 3659 3644>,
				<3403 3641 3646 3635 3614>,
				<3357 3602 3602 3588 3564>,
				<3304 3543 3536 3522 3497>,
				<3252 3453 3445 3432 3404>,
				<3174 3306 3303 3284 3245>,
				<3000 3000 3000 3000 3000>;
	};

	qcom,rbatt-sf-lut {
		qcom,lut-col-legend = <(-20) 0 25 40 60>;
		qcom,lut-row-legend = <100 95 90 85 80>,
				<75 70 65 60 55>,
				<50 45 40 35 30>,
				<25 20 16 13 11>,
				<10 9 8 7 6>,
				<5 4 3 2 1>;
		qcom,lut-data = <1108 235 100 86 81>,
				<1077 238 100 86 81>,
				<1050 241 101 87 81>,
				<987 249 105 89 83>,
				<957 252 108 91 84>,
				<898 248 113 94 86>,
				<888 232 121 98 88>,
				<886 230 130 104 92>,
				<887 227 126 111 98>,
				<886 224 106 95 89>,
				<926 225 101 87 83>,
				<987 227 101 88 84>,
				<1051 229 104 91 86>,
				<1121 231 106 93 89>,
				<1198 244 109 93 89>,
				<1296 258 110 92 85>,
				<1429 261 107 90 84>,
				<1677 267 105 89 84>,
				<2006 287 101 87 82>,
				<2060 304 101 87 84>,
				<2004 312 103 89 86>,
				<2079 313 105 91 87>,
				<2497 321 108 93 88>,
				<3258 339 112 95 90>,
				<5653 362 116 97 90>,
				<14789 390 116 95 87>,
				<36377 437 114 94 88>,
				<56375 542 119 97 92>,
				<76093 824 136 110 103>,
				<195839 7336 996 178 801>;
	};
};
