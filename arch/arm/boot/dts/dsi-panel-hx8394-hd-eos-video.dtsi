/* Copyright (c) 2013, The Linux Foundation. All rights reserved.
 *
 * This program is free software; you can redistribute it and/or modify
 * it under the terms of the GNU General Public License version 2 and
 * only version 2 as published by the Free Software Foundation.
 *
 * This program is distributed in the hope that it will be useful,
 * but WITHOUT ANY WARRANTY; without even the implied warranty of
 * MERCHANTABILITY or FITNESS FOR A PARTICULAR PURPOSE.  See the
 * GNU General Public License for more details.
 */

/*---------------------------------------------------------------------------
 * This file is autogenerated file using gcdb parser. Please do not edit it.
 * Update input XML file to add a new entry or update variable in this file
 * VERSION = "1.0"
 *---------------------------------------------------------------------------*/
&mdss_mdp {
	dsi_hx8394_hd_eos_vid: qcom,mdss_dsi_hx8394_hd_eos_video {
		compatible = "qcom,mdss-dsi-panel";
		status = "disable";
		qcom,mdss-dsi-panel-name = "hx8394 hd eos video mode panel";
		qcom,mdss-dsi-panel-controller = <&mdss_dsi0>;
		qcom,mdss-dsi-panel-type = "dsi_video_mode";
		qcom,mdss-dsi-panel-destination = "display_1";
		qcom,mdss-dsi-pixel-packing = <0>; /* used for 16bit mode*/
        qcom,mdss-dsi-panel-frame-rate = <60>;
        qcom,mdss-dsi-virtual-channel-id = <0>;
		qcom,mdss-dsi-stream = <0>;
		qcom,mdss-dsi-panel-width = <720>;
		qcom,mdss-dsi-panel-height = <1280>;
		qcom,mdss-dsi-h-front-porch = <196>;
		qcom,mdss-dsi-h-back-porch = <192>;
		qcom,mdss-dsi-h-pulse-width = <60>;
		qcom,mdss-dsi-h-sync-skew = <0>;
		qcom,mdss-dsi-v-back-porch = <10>;
		qcom,mdss-dsi-v-front-porch = <20>;
		qcom,mdss-dsi-v-pulse-width = <2>;
		qcom,mdss-dsi-h-left-border = <0>;
		qcom,mdss-dsi-h-right-border = <0>;
		qcom,mdss-dsi-v-top-border = <0>;
		qcom,mdss-dsi-v-bottom-border = <0>;
		qcom,mdss-pan-physical-width-dimension = <0>;
		qcom,mdss-pan-physical-height-dimension = <0>;
		qcom,mdss-dsi-bpp = <24>;
		qcom,mdss-dsi-color-order = <0>;
		qcom,mdss-dsi-underflow-color = <0xff>;
		qcom,mdss-dsi-border-color = <0>;
		qcom,mdss-dsi-on-command = [
                    39 01 00 00 00 00 04
                        B9 FF 83 94
					15 01 00 00 00 00 02
    					BA 13
                    39 01 00 00 00 00 11
						B1 7C 00 07 8A 01 11 11 38 3D 3F 3F 47 12 01 E6 E2
                    39 01 00 00 00 00 17
                        B4 80 06 32 10 03 32 15 08 32 10 08 33 04 43 05 37 04 3F 06 61 61 06
                    39 01 00 00 00 00 07
                        B2 00 C8 08 04 00 22
                    39 01 00 00 00 00 21
                        D5 00 00 00 00 0A 00 01 00 CC 00 00 00 88 88 88 88 88 88 88 88 88 88 01 67 45 23 01 23 88 88 88 88
                    39 01 00 00 00 00 05
                        C7 00 10 00 10
                    39 01 00 00 00 00 05
                        BF 06 02 10 04
					15 01 00 00 00 00 02
    					CC 09
                    39 01 00 00 00 00 2B
E0 00 04 06 2B 33 3F 14 34 0A 0E 0D 10 13 11 12 10 17 00 04 06 2B 33 3F 14 34 0A 0E 0D 10 13 11 12 10 17 0D 17 07 11 0D 17 07 11
                    39 01 00 00 00 00 80
C1 01 00 07 0E 15 1D 25 2D 34 3C 42 49 51 58 5F 67 6F 77 80 87 8F 98 9F A7 AF B7 C1 CB D3 DD E6 EF F6 FF 16 25 7C 62 CA 3A C2 1F C0 00 07 0E 15 1D 25 2D 34 3C 42 49 51 58 5F 67 6F 77 80 87 8F 98 9F A7 AF B7 C1 CB D3 DD E6 EF F6 FF 16 25 7C 62 CA 3A C2 1F C0 00 07 0E 15 1D 25 2D 34 3C 42 49 51 58 5F 67 6F 77 80 87 8F 98 9F A7 AF B7 C1 CB D3 DD E6 EF F6 FF 16 25 7C 62 CA 3A C2 1F C0
					15 01 00 00 00 00 02
					    B6 00
					15 01 00 00 00 00 02
					    D4 32
					15 01 00 00 00 00 02
					    35 00
					05 01 00 00 78 00 02 11 00
					05 01 00 00 14 00 02 29 00];
		qcom,mdss-dsi-off-command = [05 01 00 00 32 00 02 28 00
					05 01 00 00 78 00 02 10 00];

		qcom,mdss-dsi-on-command-state = "dsi_lp_mode";
		qcom,mdss-dsi-off-command-state = "dsi_hs_mode";
		qcom,mdss-dsi-h-sync-pulse = <1>;
		qcom,mdss-dsi-traffic-mode = <0>;
		qcom,mdss-dsi-lane-map = <0>;
		qcom,mdss-dsi-bllp-eof-power-mode;
		qcom,mdss-dsi-bllp-power-mode;
		qcom,mdss-dsi-lane-0-state;
		qcom,mdss-dsi-lane-1-state;
		qcom,mdss-dsi-lane-2-state;
		qcom,mdss-dsi-lane-3-state;
		qcom,mdss-dsi-panel-timings = [A0 22 16 00 4A 4C 1C 26 1A 03 04 00];
		qcom,mdss-dsi-t-clk-post = <0x04>;
		qcom,mdss-dsi-t-clk-pre = <0x1F>;
		qcom,mdss-dsi-panel-clock-rate = <551670000>;
		qcom,mdss-dsi-bl-min-level = <1>;
		qcom,mdss-dsi-bl-max-level = <255>;
		qcom,mdss-dsi-interleave-mode = <0>;
		qcom,mdss-dsi-dma-trigger = <4>;
		qcom,mdss-dsi-mdp-trigger = <0>;
		qcom,mdss-dsi-bl-pmic-control-type = "bl_ctrl_wled";
		qcom,mdss-dsi-reset-sequence = <1 1>, <0 20>, <1 120>;
	};
};
