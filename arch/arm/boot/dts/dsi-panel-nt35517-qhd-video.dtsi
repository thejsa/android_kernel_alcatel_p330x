/* Copyright (c) 2013, The Linux Foundation. All rights reserved.
 *
 * This program is free software; you can redistribute it and/or modify
 * it under the terms of the GNU General Public License version 2 and
 * only version 2 as published by the Free Software Foundation.
 *
 * This program is distributed in the hope that it will be useful,
 * but WITHOUT ANY WARRANTY; without even the implied warranty of
 * MERCHANTABILITY or FITNESS FOR A PARTICULAR PURPOSE.  See the
 * GNU General Public License for more details.
 */

/*---------------------------------------------------------------------------
 * This file is autogenerated file using gcdb parser. Please do not edit it.
 * Update input XML file to add a new entry or update variable in this file
 * VERSION = "1.0"
 *---------------------------------------------------------------------------*/
&soc {
	dsi_nt35590_720_vid: qcom,mdss_dsi_nt35517_qhd_video {
		compatible = "qcom,mdss-dsi-panel";
		status = "disable";
		qcom,mdss-dsi-panel-name = "nt35517 video mode dsi panel";
		qcom,mdss-dsi-panel-controller = <&mdss_dsi0>;
		qcom,mdss-dsi-panel-type = "dsi_video_mode";
		qcom,mdss-dsi-panel-destination = "display_1";
		qcom,mdss-dsi-panel-framerate = <58>; // <55>;
		qcom,mdss-dsi-virtual-channel-id = <0>;
		qcom,mdss-dsi-stream = <0>;
		qcom,mdss-dsi-panel-width = <540>;
		qcom,mdss-dsi-panel-height = <960>;
		qcom,mdss-dsi-h-front-porch = <50>;
		qcom,mdss-dsi-h-back-porch = <50>;
		qcom,mdss-dsi-h-pulse-width = <15>;
		qcom,mdss-dsi-h-sync-skew = <0>;
		qcom,mdss-dsi-v-back-porch = <13>;
		qcom,mdss-dsi-v-front-porch = <10>;
		qcom,mdss-dsi-v-pulse-width = <2>;
		qcom,mdss-dsi-h-left-border = <0>;
		qcom,mdss-dsi-h-right-border = <0>;
		qcom,mdss-dsi-v-top-border = <0>;
		qcom,mdss-dsi-v-bottom-border = <0>;
		qcom,mdss-pan-physical-width-dimension = <0>;
		qcom,mdss-pan-physical-height-dimension = <0>;
		qcom,mdss-dsi-bpp = <24>;
		qcom,mdss-dsi-color-order = <0>;
		qcom,mdss-dsi-underflow-color = <0xff>;
		qcom,mdss-dsi-border-color = <0>;
		qcom,mdss-dsi-on-command = [39 01 00 00 00 00 06
                        F0  55  AA  52  08  00
                    39 01 00 00 00 00 04
                        B1  7C  04  00
                    39 01 00 00 00 00 05
                        B8  01  02  02  02
                    39 01 00 00 00 00 04
                        BB  63  03  63
                    39 01 00 00 00 00 07
                        C9  61  06  0D  1A  17  00
//-------------------------------------
// CMD2  Page 1
//-------------------------------------
                    39 01 00 00 00 00 06
                        F0  55  AA  52  08  01
                    39 01 00 00 00 00 04
                        B0  05  05  05
                    39 01 00 00 00 00 04
                        B1  05  05  05
                    39 01 00 00 00 00 04
                        B2  01  01  01
                    39 01 00 00 00 00 04
                        B3  0E  0E  0E
                    39 01 00 00 00 00 04
                        B4  0A  0A  0A
                    39 01 00 00 00 00 04
                        B6  44  44  44
                    39 01 00 00 00 00 04
                        B7  34  34  34
                    39 01 00 00 00 00 04
                        B8  24  24  24
                    39 01 00 00 00 00 04
                        B9  26  26  26
                    39 01 00 00 00 00 04
                        BA  24  24  24
                    39 01 00 00 00 00 04
                        BC  00  C8  00
                    39 01 00 00 00 00 04
                        BD  00  C8  00
                    39 01 00 00 00 00 04
                        BC  00  A0  00
                    39 01 00 00 00 00 04
                        BD  00  A0  00

					15 01 00 00 00 00 02
                        BF  45
                    39 01 00 00 00 00 03
                        C0  00  08
					15 01 00 00 00 00 02
                        CA  00

                    39 01 00 00 00 00 05
                        D0  0A  10  0D  0F
                    39 01 00 00 00 00 11
                        D1  00 15 00 40 00 6D 00 8C 00 9E 00 CB 00 EC 01 1C
                    39 01 00 00 00 00 11
                        D5  00 15 00 40 00 6D 00 8C 00 9E 00 CB 00 EC 01 1C
                    39 01 00 00 00 00 11
                        D9  00 15 00 40 00 6D 00 8C 00 9E 00 CB 00 EC 01 1C
                    39 01 00 00 00 00 11
                        E0  00 15 00 40 00 6D 00 8C 00 9E 00 CB 00 EC 01 1C
                    39 01 00 00 00 00 11
                        E4  00 15 00 40 00 6D 00 8C 00 9E 00 CB 00 EC 01 1C
                    39 01 00 00 00 00 11
                        E8  00 15 00 40 00 6D 00 8C 00 9E 00 CB 00 EC 01 1C
                    39 01 00 00 00 00 11
                        D2  01 40 01 7B 01 A8 01 ED 02 26 02 28 02 5F 02 9B
                    39 01 00 00 00 00 11
                        D6  01 40 01 7B 01 A8 01 ED 02 26 02 28 02 5F 02 9B
                    39 01 00 00 00 00 11
                        DD  01 40 01 7B 01 A8 01 ED 02 26 02 28 02 5F 02 9B
                    39 01 00 00 00 00 11
                        E1  01 40 01 7B 01 A8 01 ED 02 26 02 28 02 5F 02 9B
                    39 01 00 00 00 00 11
                        E5  01 40 01 7B 01 A8 01 ED 02 26 02 28 02 5F 02 9B
                    39 01 00 00 00 00 11
                        E9  01 40 01 7B 01 A8 01 ED 02 26 02 28 02 5F 02 9B
                    39 01 00 00 00 00 11
                        D3  02 C2 02 F7 03 1D 03 4F 03 72 03 9C 03 B4 03 D6
                    39 01 00 00 00 00 11
                        D7  02 C2 02 F7 03 1D 03 4F 03 72 03 9C 03 B4 03 D6
                    39 01 00 00 00 00 11
                        DE  02 C2 02 F7 03 1D 03 4F 03 72 03 9C 03 B4 03 D6
                    39 01 00 00 00 00 11
                        E2  02 C2 02 F7 03 1D 03 4F 03 72 03 9C 03 B4 03 D6
                    39 01 00 00 00 00 11
                        E6  02 C2 02 F7 03 1D 03 4F 03 72 03 9C 03 B4 03 D6
                    39 01 00 00 00 00 11
                        EA  02 C2 02 F7 03 1D 03 4F 03 72 03 9C 03 B4 03 D6
                    39 01 00 00 00 00 05
                        D4  03 F6 03 FF
                    39 01 00 00 00 00 05
                        D8  03 F6 03 FF
                    39 01 00 00 00 00 05
                        DF  03 F6 03 FF
                    39 01 00 00 00 00 05
                        E3  03 F6 03 FF
                    39 01 00 00 00 00 05
                        E7  03 F6 03 FF
                    39 01 00 00 00 00 05
                        EB  03 F6 03 FF
// NT50198 mode
					15 01 00 00 00 00 02
                        C0 C0
					15 01 00 00 00 00 02
                        C2 20
//\ufffd\u057e\ufffdsequence
                    39 01 00 00 00 00 05
                        FF AA 55 25 01
					15 01 00 00 00 00 02
                        6F 0B
                    39 01 00 00 00 00 05
                        F4 12 12 56 13
					05 01 00 00 78 00 02 11 00
					05 01 00 00 32 00 02 29 00];
		qcom,mdss-dsi-off-command = [05 01 00 00 32 00 02 28 00
					05 01 00 00 78 00 02 10 00];
		qcom,mdss-dsi-on-command-state = "dsi_lp_mode";
		qcom,mdss-dsi-off-command-state = "dsi_hs_mode";
		qcom,mdss-dsi-h-sync-pulse = <1>;
		qcom,mdss-dsi-traffic-mode = "non_burst_sync_event";
		qcom,mdss-dsi-lane-map = "lane_map_3012";
		qcom,mdss-dsi-bllp-eof-power-mode;
		qcom,mdss-dsi-bllp-power-mode;
		qcom,mdss-dsi-lane-0-state;
		qcom,mdss-dsi-lane-1-state;
		qcom,mdss-dsi-panel-clockrate = <449000000>;
		qcom,mdss-dsi-panel-timings = [bf 1c 12 00 40 44 16 1e 17 03 04 00];
		qcom,mdss-dsi-t-clk-post = <0x04>;
		qcom,mdss-dsi-t-clk-pre = <0x34>;
		qcom,mdss-dsi-bl-min-level = <1>;
		qcom,mdss-dsi-bl-max-level = <255>;
		qcom,mdss-dsi-interleave-mode = <0>;
		qcom,mdss-dsi-dma-trigger = "trigger_sw";
		qcom,mdss-dsi-mdp-trigger = "none";
		qcom,mdss-dsi-bl-pmic-control-type = "bl_ctrl_wled";
		qcom,mdss-dsi-reset-sequence = <1 1>, <0 20>, <1 120>;
	};
};
