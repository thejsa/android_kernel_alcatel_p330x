/* Copyright (c) 2013, The Linux Foundation. All rights reserved.
 *
 * This program is free software; you can redistribute it and/or modify
 * it under the terms of the GNU General Public License version 2 and
 * only version 2 as published by the Free Software Foundation.
 *
 * This program is distributed in the hope that it will be useful,
 * but WITHOUT ANY WARRANTY; without even the implied warranty of
 * MERCHANTABILITY or FITNESS FOR A PARTICULAR PURPOSE.  See the
 * GNU General Public License for more details.
 */

/*---------------------------------------------------------------------------
 * This file is autogenerated file using gcdb parser. Please do not edit it.
 * Update input XML file to add a new entry or update variable in this file
 * VERSION = "1.0"
 *---------------------------------------------------------------------------*/
&mdss_mdp {
	dsi_ILI9806E_wvga_vid: qcom,mdss_dsi_ILI9806E_wvga_video {
		compatible = "qcom,mdss-dsi-panel";
		status = "disable";
		qcom,mdss-dsi-panel-name = "ILI9806E video mode panel";
		qcom,mdss-dsi-panel-controller = <&mdss_dsi0>;
		qcom,mdss-dsi-panel-type = "dsi_video_mode";
		qcom,mdss-dsi-panel-destination = "display_1";
		qcom,mdss-dsi-pixel-packing = <0>; /* used for 16bit mode*/
        qcom,mdss-dsi-panel-framerate = <50>;
        qcom,mdss-dsi-virtual-channel-id = <0>;
		qcom,mdss-dsi-stream = <0>;
		qcom,mdss-dsi-panel-width = <480>;
		qcom,mdss-dsi-panel-height = <800>;
		qcom,mdss-dsi-h-front-porch = <100>;
		qcom,mdss-dsi-h-back-porch = <140>;
		qcom,mdss-dsi-h-pulse-width = <120>;
		qcom,mdss-dsi-h-sync-skew = <0>;
		qcom,mdss-dsi-v-back-porch = <10>;
		qcom,mdss-dsi-v-front-porch = <20>;
		qcom,mdss-dsi-v-pulse-width = <2>;
		qcom,mdss-dsi-h-left-border = <0>;
		qcom,mdss-dsi-h-right-border = <0>;
		qcom,mdss-dsi-v-top-border = <0>;
		qcom,mdss-dsi-v-bottom-border = <0>;
		qcom,mdss-pan-physical-width-dimension = <0>;
		qcom,mdss-pan-physical-height-dimension = <0>;
		qcom,mdss-dsi-bpp = <24>;
		qcom,mdss-dsi-color-order = <0>;
		qcom,mdss-dsi-underflow-color = <0xff>;
		qcom,mdss-dsi-border-color = <0>;
		qcom,mdss-dsi-on-command = [
                        39 01 00 00 00 00 06 FF FF 98 06 04 01
			15 01 00 00 00 00 02 08 10
			15 01 00 00 00 00 02 21 01
                        15 01 00 00 00 00 02 30 02
                        15 01 00 00 00 00 02 31 02
                        15 01 00 00 00 00 02 40 16
                        15 01 00 00 00 00 02 41 33
                        15 01 00 00 00 00 02 42 03
                        15 01 00 00 00 00 02 43 02
                        15 01 00 00 00 00 02 44 02
                        15 01 00 00 00 00 02 45 06
                        15 01 00 00 00 00 02 50 80
                        15 01 00 00 00 00 02 51 80
                        15 01 00 00 00 00 02 60 07
                        15 01 00 00 00 00 02 61 00
                        15 01 00 00 00 00 02 62 08
                        15 01 00 00 00 00 02 63 00
                        15 01 00 00 00 00 02 52 00
                        15 01 00 00 00 00 02 53 8C
                        15 01 00 00 00 00 02 57 50
                        15 01 00 00 00 00 02 A0 00
                        15 01 00 00 00 00 02 A1 01
                        15 01 00 00 00 00 02 A2 12
                        15 01 00 00 00 00 02 A3 11
                        15 01 00 00 00 00 02 A4 0E
                        15 01 00 00 00 00 02 A5 1A
                        15 01 00 00 00 00 02 A6 09
                        15 01 00 00 00 00 02 A7 09
                        15 01 00 00 00 00 02 A8 01
                        15 01 00 00 00 00 02 A9 0E
                        15 01 00 00 00 00 02 AA 00
                        15 01 00 00 00 00 02 AB 01
                        15 01 00 00 00 00 02 AC 0A
                        15 01 00 00 00 00 02 AD 26
                        15 01 00 00 00 00 02 AE 24
                        15 01 00 00 00 00 02 AF 00
                        15 01 00 00 00 00 02 C0 00
                        15 01 00 00 00 00 02 C1 03
                        15 01 00 00 00 00 02 C2 07
                        15 01 00 00 00 00 02 C3 0B
                        15 01 00 00 00 00 02 C4 03
                        15 01 00 00 00 00 02 C5 14
                        15 01 00 00 00 00 02 C6 0D
                        15 01 00 00 00 00 02 C7 09
                        15 01 00 00 00 00 02 C8 06
                        15 01 00 00 00 00 02 C9 00
                        15 01 00 00 00 00 02 CA 0B
                        15 01 00 00 00 00 02 CB 05
                        15 01 00 00 00 00 02 CC 0C
                        15 01 00 00 00 00 02 CD 33
                        15 01 00 00 00 00 02 CE 2A
                        15 01 00 00 00 00 02 CF 00
                        39 01 00 00 00 00 06 FF FF 98 06 04 06
                        15 01 00 00 00 00 02 00 21
                        15 01 00 00 00 00 02 01 06
                        15 01 00 00 00 00 02 02 00
                        15 01 00 00 00 00 02 03 00
                        15 01 00 00 00 00 02 04 01
                        15 01 00 00 00 00 02 05 01
                        15 01 00 00 00 00 02 06 80
                        15 01 00 00 00 00 02 07 02
                        15 01 00 00 00 00 02 08 05
                        15 01 00 00 00 00 02 09 00
                        15 01 00 00 00 00 02 0A 00
                        15 01 00 00 00 00 02 0B 00
                        15 01 00 00 00 00 02 0C 01
                        15 01 00 00 00 00 02 0D 01
                        15 01 00 00 00 00 02 0E 00
                        15 01 00 00 00 00 02 0F 00
                        15 01 00 00 00 00 02 10 F0
                        15 01 00 00 00 00 02 11 F4
                        15 01 00 00 00 00 02 12 00
                        15 01 00 00 00 00 02 13 00
                        15 01 00 00 00 00 02 14 00
                        15 01 00 00 00 00 02 15 C0
                        15 01 00 00 00 00 02 16 08
                        15 01 00 00 00 00 02 17 00
                        15 01 00 00 00 00 02 18 00
                        15 01 00 00 00 00 02 19 00
                        15 01 00 00 00 00 02 1A 00
                        15 01 00 00 00 00 02 1B 00
                        15 01 00 00 00 00 02 1C 00
                        15 01 00 00 00 00 02 1D 00
                        15 01 00 00 00 00 02 20 02
                        15 01 00 00 00 00 02 21 13
                        15 01 00 00 00 00 02 22 45
                        15 01 00 00 00 00 02 23 67
                        15 01 00 00 00 00 02 24 01
                        15 01 00 00 00 00 02 25 23
                        15 01 00 00 00 00 02 26 45
                        15 01 00 00 00 00 02 27 67
                        15 01 00 00 00 00 02 30 13
                        15 01 00 00 00 00 02 31 22
                        15 01 00 00 00 00 02 32 22
                        15 01 00 00 00 00 02 33 22
                        15 01 00 00 00 00 02 34 22
                        15 01 00 00 00 00 02 35 BB
                        15 01 00 00 00 00 02 36 AA
                        15 01 00 00 00 00 02 37 DD
                        15 01 00 00 00 00 02 38 CC
                        15 01 00 00 00 00 02 39 66
                        15 01 00 00 00 00 02 3A 77
                        15 01 00 00 00 00 02 3B 22
                        15 01 00 00 00 00 02 3C 22
                        15 01 00 00 00 00 02 3D 22
                        15 01 00 00 00 00 02 3E 22
                        15 01 00 00 00 00 02 3F 22
                        15 01 00 00 00 00 02 40 22
                        15 01 00 00 00 00 02 52 12
                        15 01 00 00 00 00 02 53 12
                        39 01 00 00 00 00 06 FF FF 98 06 04 07
                        15 01 00 00 00 00 02 17 32
                        15 01 00 00 00 00 02 02 77
                        15 01 00 00 00 00 02 E1 79
                        39 01 00 00 00 00 06 FF FF 98 06 04 00
                        15 01 00 00 78 00 02 11 00
                        15 01 00 00 32 00 02 29 00];
		qcom,mdss-dsi-off-command = [05 01 00 00 32 00 02 28 00
					05 01 00 00 78 00 02 10 00];

		qcom,mdss-dsi-on-command-state = "dsi_lp_mode";
		qcom,mdss-dsi-off-command-state = "dsi_hs_mode";
		qcom,mdss-dsi-h-sync-pulse = <1>;
		qcom,mdss-dsi-traffic-mode = "non_burst_sync_event";
		qcom,mdss-dsi-lane-map = "lane_map_3012";
		qcom,mdss-dsi-bllp-eof-power-mode;
		qcom,mdss-dsi-bllp-power-mode;
		qcom,mdss-dsi-lane-0-state;
		qcom,mdss-dsi-lane-1-state;
//		qcom,mdss-dsi-lane-2-state;
//		qcom,mdss-dsi-lane-3-state;
		qcom,mdss-dsi-panel-timings = [BB 1A 10 00 3E 40 16 1E 15 03 04 00];
		qcom,mdss-dsi-t-clk-post = <0x04>;
		qcom,mdss-dsi-t-clk-pre = <0x33>;
		qcom,mdss-dsi-panel-clockrate = <419300000>;
		qcom,mdss-dsi-bl-min-level = <1>;
		qcom,mdss-dsi-bl-max-level = <255>;
		qcom,mdss-dsi-interleave-mode = <0>;
		qcom,mdss-dsi-dma-trigger = "trigger_sw";
		qcom,mdss-dsi-mdp-trigger = "none";
		qcom,mdss-dsi-bl-pmic-control-type = "bl_ctrl_wled";
		qcom,mdss-dsi-reset-sequence = <1 20>, <0 2>, <1 20>;
	};
};
