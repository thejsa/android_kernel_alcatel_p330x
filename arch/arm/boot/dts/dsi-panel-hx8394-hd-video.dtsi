/* Copyright (c) 2013, The Linux Foundation. All rights reserved.
 *
 * This program is free software; you can redistribute it and/or modify
 * it under the terms of the GNU General Public License version 2 and
 * only version 2 as published by the Free Software Foundation.
 *
 * This program is distributed in the hope that it will be useful,
 * but WITHOUT ANY WARRANTY; without even the implied warranty of
 * MERCHANTABILITY or FITNESS FOR A PARTICULAR PURPOSE.  See the
 * GNU General Public License for more details.
 */

/*---------------------------------------------------------------------------
 * This file is autogenerated file using gcdb parser. Please do not edit it.
 * Update input XML file to add a new entry or update variable in this file
 * VERSION = "1.0"
 *---------------------------------------------------------------------------*/
&mdss_mdp {
	dsi_hx8394_hd_vid: qcom,mdss_dsi_hx8394_hd_video {
		compatible = "qcom,mdss-dsi-panel";
		status = "disable";
		qcom,mdss-dsi-panel-name = "hx8394-A hd video mode panel";
		qcom,mdss-dsi-panel-controller = <&mdss_dsi0>;
		qcom,mdss-dsi-panel-type = "dsi_video_mode";
		qcom,mdss-dsi-panel-destination = "display_1";
		qcom,mdss-dsi-pixel-packing = <0>; /* used for 16bit mode*/
        qcom,mdss-dsi-panel-framerate = <60>;
        qcom,mdss-dsi-virtual-channel-id = <0>;
		qcom,mdss-dsi-stream = <0>;
		qcom,mdss-dsi-panel-width = <720>;
		qcom,mdss-dsi-panel-height = <1280>;
		qcom,mdss-dsi-h-front-porch = <100>;//<200>;
		qcom,mdss-dsi-h-back-porch = <120>;//<175>;
		qcom,mdss-dsi-h-pulse-width = <8>;
		qcom,mdss-dsi-h-sync-skew = <0>;
		qcom,mdss-dsi-v-back-porch = <12>;//<10>;
		qcom,mdss-dsi-v-front-porch = <20>;//<20>;
		qcom,mdss-dsi-v-pulse-width = <4>;//<2>;
		qcom,mdss-dsi-h-left-border = <0>;
		qcom,mdss-dsi-h-right-border = <0>;
		qcom,mdss-dsi-v-top-border = <0>;
		qcom,mdss-dsi-v-bottom-border = <0>;
		qcom,mdss-pan-physical-width-dimension = <0>;
		qcom,mdss-pan-physical-height-dimension = <0>;
		qcom,mdss-dsi-bpp = <24>;
		qcom,mdss-dsi-color-order = <0>;
		qcom,mdss-dsi-underflow-color = <0xff>;
		qcom,mdss-dsi-border-color = <0>;
		qcom,mdss-dsi-reset-command = [
            05 01 00 00 78 00 02 11 00
            05 01 00 00 14 00 02 29 00
            05 01 00 00 14 00 02 38 00
        ];
		qcom,mdss-dsi-on-command = [
            39 01 00 00 00 00 04
                B9 FF 83 94
            39 01 00 00 00 00 11
                BA 13 82 00 16 C5 00 10 FF 0F 24 03 21 24 25 20 08
            39 01 00 00 00 00 11
                B1 01 00 54 87 01 11 11 35 3D 29 29 47 12 01 E6 E2
            39 01 00 00 00 00 17
                B4 80 08 32 10 06 32 15 08 32 10 08 33 05 44 0A 37 05 44 0A 68 68 0A
            39 01 00 00 00 00 37
                D5 00 00 0F 00 0A 00 01 00 00 00 33 00 45 67 01 23 01 23 88 88 88 99 88 AA BB 99 99 99 88 88 88 88 32 10 76 54 32 10 88 88 88 88 99 BB AA 99 99 99 88 88 88 88 1E 08
            39 01 00 00 00 00 2B
                E0 00 08 0D 37 3F 3F 1D 3F 07 0D 0E 11 13 11 12 11 18 00 08 0D 37 3F 3F 1D 3F 07 0D 0E 11 13 11 12 11 18 0B 17 06 11 0B 17 06 11
            39 01 00 00 00 00 80
                C1 01 00 0A 12 1B 23 2A 32 3B 42 49 51 59 61 69 71 7A 82 89 91 9A A2 AA B3 BA C2 CB D2 DA E3 EA F1 F8 FF 08 7C A5 1E 7C 17 EA 1A C0 00 0A 12 1B 23 2A 32 3B 42 49 51 59 61 69 71 7A 82 89 91 9A A2 AA B3 BA C2 CB D2 DA E3 EA F1 F8 FF 08 7C A5 1E 7C 17 EA 1A C0 00 0A 12 1B 23 2A 32 3B 42 49 51 59 61 69 71 7A 82 89 91 9A A2 AA B3 BA C2 CB D2 DA E3 EA F1 F8 FF 08 7C A5 1E 7C 17 EA 1A C0
            15 01 00 00 00 00 02
                B6 3C
            39 01 00 00 00 00 05
                BF 06 00 10 04
            39 01 00 00 00 00 03
                C0 0C 14
            39 01 00 00 00 00 05
                C7 00 10 00 10
            39 01 00 00 00 00 07
                B2 00 C8 0F 05 00 22
            15 01 00 00 00 00 02
                CC 09           // this controls display flip on vertical side
            15 01 00 00 00 00 02
                BC 07
            39 01 00 00 00 00 03
                C6 08 40
            15 01 00 00 00 00 02
                D4 32
            15 01 00 00 00 00 02
                35 00
            05 01 00 00 78 00 02 11 00
            05 01 00 00 14 00 02 29 00
		];
		qcom,mdss-dsi-off-command = [05 01 00 00 32 00 02 28 00
					05 01 00 00 78 00 02 10 00];

		qcom,mdss-dsi-on-command-state = "dsi_lp_mode";
		qcom,mdss-dsi-off-command-state = "dsi_hs_mode";
		qcom,mdss-dsi-h-sync-pulse = <1>;
		qcom,mdss-dsi-traffic-mode = "non_burst_sync_event";
		qcom,mdss-dsi-lane-map = "lane_map_3012";
		qcom,mdss-dsi-bllp-eof-power-mode;
		qcom,mdss-dsi-bllp-power-mode;
		qcom,mdss-dsi-lane-0-state;
		qcom,mdss-dsi-lane-1-state;
		qcom,mdss-dsi-lane-2-state;
		qcom,mdss-dsi-lane-3-state;
		qcom,mdss-dsi-panel-timings = [b7 1c 12 00 40 44 16 1e 17 03 04 00];
		qcom,mdss-dsi-t-clk-post = <0x04>;
		qcom,mdss-dsi-t-clk-pre = <0x33>;
		qcom,mdss-dsi-panel-clockrate = <449100000>;
		qcom,mdss-dsi-bl-min-level = <1>;
		qcom,mdss-dsi-bl-max-level = <255>;
		qcom,mdss-dsi-interleave-mode = <0>;
		qcom,mdss-dsi-dma-trigger = "trigger_sw";
		qcom,mdss-dsi-mdp-trigger = "none";
		qcom,mdss-dsi-bl-pmic-control-type = "bl_ctrl_wled";
		qcom,mdss-dsi-reset-sequence = <1 20>, <0 2>, <1 20>;
	};
};
